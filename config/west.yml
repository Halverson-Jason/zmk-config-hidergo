## config/west.yml
```yaml
manifest:
  remotes:
    - name: Halverson-Jason
      url-base: https://github.com/Halverson-Jason
  projects:
    - name: zmk
      remote: Halverson-Jason
      revision: main
      import: app/west.yml
  self:
    path: config
```
